## boards/adafruit/feather_rp2350/Kconfig.feather_rp2350
```kconfig
# SPDX-License-Identifier: Apache-2.0 OR MIT
# SPDX-FileCopyrightText: Copyright 2025 Sam Blenny

config BOARD_FEATHER_RP2350
	select SOC_RP2350A_M33
```

## boards/adafruit/feather_rp2350/feather_rp2350_rp2350a_m33_defconfig
```kconfig
CONFIG_BUILD_OUTPUT_HEX=y
CONFIG_BUILD_OUTPUT_UF2=y
CONFIG_CLOCK_CONTROL=y
CONFIG_SYS_CLOCK_HW_CYCLES_PER_SEC=150000000
CONFIG_USE_DT_CODE_PARTITION=y
CONFIG_I2C=y
CONFIG_I2C_SHELL=y
CONFIG_SENSOR=y
CONFIG_SENSOR_SHELL=y
CONFIG_SHT4X=y

# Turn off shell extras
CONFIG_SHELL_CMDS_RESIZE=n
CONFIG_SHELL_CMDS_SELECT=n
CONFIG_SHELL_CMDS_RETURN_VALUE=n
CONFIG_SHELL_DEVICE_HELPERS=n
CONFIG_SHELL_PROMPT_CHANGE=n
CONFIG_SHELL_METAKEYS=n
CONFIG_SHELL_STATS=n
CONFIG_DATE_SHELL=n
CONFIG_DEVICE_SHELL=n
CONFIG_DEVMEM_SHELL=n
CONFIG_KERNEL_SHELL=n
CONFIG_STATS=n
CONFIG_STATS_SHELL=n
```
